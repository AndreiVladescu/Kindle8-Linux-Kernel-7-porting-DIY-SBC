// SPDX-License-Identifier: (GPL-2.0+ OR MIT)
/*
 * Optional overclock for imx6sl-amazon-heisenberg.dts: to use it, #include this file at the end of
 * the board DTS. Tested 2026-11-01 on one unit (speed-grade fuse = 996 MHz): 10 min stress-ng
 * --verify (all CPU methods + vm) at 1104 MHz, 0 failures, SoC max 48.1 degC. See docs/cpufreq.md.
 */
/*
 * OVERCLOCK EXPERIMENT (not for the normal slot): adds 1104 MHz (PLL1 = 24 MHz * 92 / 2) at 1.3 V, the
 * VDD_ARM_CAP maximum. The speed-grade fuse of this part says 996 MHz.
 */
&cpu0 {
	operating-points =
		/* kHz    uV */
		<1104000 1300000>,
		<996000  1275000>,
		<792000  1175000>,
		<396000  975000>;
	fsl,soc-operating-points =
		/* ARM kHz  SOC-PU uV */
		<1104000    1225000>,
		<996000     1225000>,
		<792000     1175000>,
		<396000     1175000>;
};
